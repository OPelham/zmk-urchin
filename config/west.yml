## config/west.yml
```yaml
manifest:
  remotes:
      # zmk fork with mouse emulation
    - name: zmkfirmware
      url-base: https://github.com/petejohanson/
      # bravekarma
    - name: caksoylar
      url-base: https://github.com/caksoylar
      # nice-view-gem
    - name: m165437
      url-base: https://github.com/M165437
  projects:
    - name: zmk
      remote: zmkfirmware
      revision: feat/pointers-move-scroll
      import: app/west.yml
    - name: nice-view-gem
      remote: m165437
      revision: main
  self:
    path: config
```
